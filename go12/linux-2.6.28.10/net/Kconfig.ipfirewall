## go12/linux-2.6.28.10/sound/soc/bcm476x/Kconfig
```kconfig
# ALSA SND-SOC BCM476X drivers

config SND_BCM476X_SOC
	tristate "Broadcom Sound Driver BCM476X"
	depends on SND && PLAT_BCM476X
	select SND_PCM
	help
	  Say Y or M if you want to add support for codecs attached to
	  the BCM476X or I2S interfaces. You will also need to
	  select the audio interfaces to support below.
	  
config SND_BCM476X_SOC_I2S
	tristate

config SND_BCM476X_SOC_INTERNAL
	tristate "Internal bcm476x sound support"
    depends on SND_BCM476X_SOC	
	select SND_SOC_BCM476X
	
config SND_BCM476X_SOC_EXTERNAL
	tristate
	
config SND_BCM476X_SOC_EXT_WM8750
    tristate "External WM8750 support"
    depends on SND_BCM476X_SOC
	select SND_SOC_WM8750
	select SND_BCM476X_SOC_I2S
	select SND_BCM476X_SOC_EXTERNAL

config SND_BCM476X_SOC_EXT_RT5627
    tristate "External RT5627 support"
    depends on SND_BCM476X_SOC    
	select SND_SOC_RT5627
	select SND_BCM476X_SOC_I2S
	select SND_BCM476X_SOC_EXTERNAL
    
	
```

## go12/linux-2.6.28.10/sound/soc/s3c24xx/Kconfig
```kconfig
config SND_S3C24XX_SOC
	tristate "SoC Audio for the Samsung S3CXXXX chips"
	depends on ARCH_S3C2410 || ARCH_S3C64XX || ARCH_S5P64XX
	help
	  Say Y or M if you want to add support for codecs attached to
	  the S3C24XX AC97, I2S or SSP interface. You will also need
	  to select the audio interfaces to support below.

config SND_S3C24XX_SOC_I2S
	tristate

config SND_S3C_I2SV2_SOC
	tristate

config SND_S3C_PCM_SOC
	tristate

config SND_S3C2412_SOC_I2S
	tristate

config SND_S3C64XX_SOC_I2S
	tristate
	select SND_S3C_I2SV2_SOC

config SND_S5P64XX_SOC_I2S
	tristate
	select SND_S3C_I2SV2_SOC

config SND_S3C2443_SOC_AC97
	tristate
	select AC97_BUS
	select SND_SOC_AC97_BUS

config SND_S3C64XX_SOC_PCM
	tristate
	select SND_S3C_PCM_SOC

config SND_S3C24XX_SOC_NEO1973_WM8753
	tristate "SoC I2S Audio support for NEO1973 - WM8753"
	depends on SND_S3C24XX_SOC && MACH_NEO1973_GTA01
	select SND_S3C24XX_SOC_I2S
	select SND_SOC_WM8753
	help
	  Say Y if you want to add support for SoC audio on smdk2440
	  with the WM8753.

config SND_S3C64XX_SOC_WM8580
	tristate "SoC I2S Audio support for WM8580 on SMDK64XX"
	depends on SND_S3C24XX_SOC && (MACH_SMDK6400 || MACH_SMDK6410 || MACH_SMDK6440)
	select SND_SOC_WM8580
	select SND_S3C64XX_SOC_I2S if ARCH_S3C64XX
	select SND_S5P64XX_SOC_I2S if ARCH_S5P64XX
	help
	  Sat Y if you want to add support for SoC audio on the SMDK64XX.

config SND_WM8580_MASTER
	bool "WM8580 Codec is I2S Master"
	depends on SND_S3C64XX_SOC_WM8580
	default n
	help
	  Say Y if you want to run SoC as I2S-Slave and CODEC as I2S-Master.

config  SND_HAVANA_TLV320ADC3101
	tristate "TLV320ADC3101-I2S on Havana"
	depends on SND_S3C24XX_SOC && MACH_HAVANA
	select SND_S3C64XX_SOC_I2S if ARCH_S3C64XX
	select SND_S5P64XX_SOC_I2S if ARCH_S5P64XX
	select SND_SOC_TLV320ADC3101

config  SND_HAVANA_S5M8751
	tristate "S5M8751-I2S on Havana"
	depends on SND_S3C24XX_SOC && MACH_HAVANA
	select SND_S3C64XX_SOC_I2S if ARCH_S3C64XX
	select SND_S5P64XX_SOC_I2S if ARCH_S5P64XX
	select SND_SOC_S5M8751

config  SND_CATANIA_TLV320ADC3101
	tristate "TLV320ADC3101-I2S on Catania"
	depends on SND_S3C24XX_SOC && MACH_CATANIA_S
	select SND_S3C64XX_SOC_I2S if ARCH_S3C64XX
	select SND_S5P64XX_SOC_I2S if ARCH_S5P64XX
	select SND_SOC_TLV320ADC3101

config SND_CATANIA_BC6
	tristate "BC6 support for Catania"
	depends on SND_S3C24XX_SOC && MACH_CATANIA_S
	select SND_S3C64XX_SOC_PCM
	select SND_SOC_BC6
	default n

config SND_HAVANA_BC6
	tristate "BC6 support for Havana"
	depends on SND_S3C24XX_SOC && MACH_HAVANA
	select SND_S3C64XX_SOC_PCM
	select SND_SOC_BC6
	default n

config  SND_CATANIA_S5M8751
	tristate "S5M8751-I2S on Catania"
	depends on SND_S3C24XX_SOC && MACH_CATANIA_S
	select SND_S3C64XX_SOC_I2S if ARCH_S3C64XX
	select SND_S5P64XX_SOC_I2S if ARCH_S5P64XX
	select SND_SOC_S5M8751
	
config  SND_CORDOBA_TLV320ADC3101
	tristate "TLV320ADC3101-I2S on Cordoba"
	depends on SND_S3C24XX_SOC && MACH_CORDOBA
	select SND_S3C64XX_SOC_I2S if ARCH_S3C64XX
	select SND_S5P64XX_SOC_I2S if ARCH_S5P64XX
	select SND_SOC_TLV320ADC3101

config  SND_CORDOBA_S5M8751
	tristate "S5M8751-I2S on Cordoba"
	depends on SND_S3C24XX_SOC && MACH_CORDOBA
	select SND_S3C64XX_SOC_I2S if ARCH_S3C64XX
	select SND_S5P64XX_SOC_I2S if ARCH_S5P64XX
	select SND_SOC_S5M8751

config SND_CORDOBA_ADAU1761
	tristate "ADAU1761-I2S on Cordoba"
	depends on SND_S3C24XX_SOC && MACH_CORDOBA
	select SND_S3C64XX_SOC_I2S if ARCH_S3C64XX
	select SND_S5P64XX_SOC_I2S if ARCH_S5P64XX
	select SND_SOC_ADAU1761

config SND_SEOUL_ADAU1761
	tristate "ADAU1761-I2S on Seoul/Lima"
	depends on SND_S3C24XX_SOC && (MACH_SEOUL || MACH_LIMA)
	select SND_S3C64XX_SOC_I2S if ARCH_S3C64XX
	select SND_S5P64XX_SOC_I2S if ARCH_S5P64XX
	select SND_SOC_ADAU1761

config SND_VENICE_ADAU1761
	tristate "ADAU1761-I2S on Venice"
	depends on SND_S3C24XX_SOC && MACH_VENICE
	select SND_S3C64XX_SOC_I2S if ARCH_S3C64XX
	select SND_S5P64XX_SOC_I2S if ARCH_S5P64XX
	select SND_SOC_ADAU1761

config SND_TORINOS_WM8990
	tristate "WM8990-I2S on TorinoS"
	depends on SND_S3C24XX_SOC && MACH_TORINOS
	select SND_S3C64XX_SOC_I2S if ARCH_S3C64XX
	select SND_S5P64XX_SOC_I2S if ARCH_S5P64XX
	select SND_SOC_WM8990

config SND_TOKYO_DUMMY_CODEC
	tristate "DUMMY-I2S on Tokyo"
	depends on SND_S3C24XX_SOC && (MACH_LIMA || MACH_LIMA_SOUNDWELL)
	select SND_S3C_I2S_V32
	select SND_SOC_DUMMY
	help
	  Say Y if you want to use a dummy codec, for I2S on Tokyo
	

config SND_S3C24XX_SOC_SMDK2443_WM9710
	tristate "SoC AC97 Audio support for SMDK2443 - WM9710"
	depends on SND_S3C24XX_SOC && MACH_SMDK2443
	select SND_S3C2443_SOC_AC97
	select SND_SOC_AC97_CODEC
	help
	  Say Y if you want to add support for SoC audio on smdk2443
	  with the WM9710.

config SND_S3C24XX_SOC_LN2440SBC_ALC650
	tristate "SoC AC97 Audio support for LN2440SBC - ALC650"
	depends on SND_S3C24XX_SOC
	select SND_S3C2443_SOC_AC97
	select SND_SOC_AC97_CODEC
	help
	  Say Y if you want to add support for SoC audio on ln2440sbc
	  with the ALC650.

config SND_SOC_TLV320ADC3101_DSP
	bool "Enable DSP support for TLV320ADC3101"
	default n
	depends on SND_CORDOBA_TLV320ADC3101 || SND_HAVANA_TLV320ADC3101 || SND_CATANIA_TLV320ADC3101
	help
	  Say Y if you want to enable DSP support for
	  the TLV320ADC3101 codec.

config SND_SOC_TLV320ADC3101_DEBUG
	bool "Enable debug output for TLV320ADC3101"
	default n
	depends on SND_SOC_TLV320ADC3101
	help
	  Say Y if you want to enable debug output for
	  the TLV320ADC3101 codec.

config SND_SOC_S5M8751_DEBUG
	bool "Enable debug output for S5M8751"
	default n
	depends on SND_SOC_S5M8751
	help
	  Say Y if you want to enable debug output for
	  the S5M8751 codec.

config SND_SOC_ADAU1761_DEBUG
	bool "Enable debug output for ADAU1761"
	default n
	depends on SND_SOC_ADAU1761
	help
	  Say Y if you want to enable debug output for
	  the ADAU1761 codec.

config SND_SOC_WM8990_DEBUG
	bool "Enable debug output for WM8990"
	default n
	depends on SND_SOC_WM8990
	help
	  Say Y if you want to enable debug output for
	  the WM8990 codec.

config SND_SOC_ADAU1761_INFREQ
	int
	default 256 if SND_SOC_ADAU1761_INFREQ_256FS
	default 512 if SND_SOC_ADAU1761_INFREQ_512FS
	default 768 if SND_SOC_ADAU1761_INFREQ_768FS

choice
	prompt "ADAU1761 INFREQ Select"
	depends on SND_SOC_ADAU1761

config SND_SOC_ADAU1761_INFREQ_256FS
	bool "256*Fs"
	depends on SND_SOC_ADAU1761
	help
	  Say Y here to select a INFREQ of 256*Fs.
config SND_SOC_ADAU1761_INFREQ_512FS
	bool "512*Fs"
	depends on SND_SOC_ADAU1761
	help
	  Say Y here to select a INFREQ of 512*Fs.
config SND_SOC_ADAU1761_INFREQ_768FS
	bool "768*Fs"
	depends on SND_SOC_ADAU1761
	help
	  Say Y here to select a INFREQ of 768*Fs.
endchoice
```

## go9/linux-s3c24xx/arch/arm/mach-s3c2410/cpufreq/Kconfig
```kconfig
#
# CPU Frequency scaling
#

#menu "CPU Frequency scaling"

if CPU_FREQ && ARCH_S3C2410

comment "CPUFreq processor drivers"

config S3C24XX_DVS_CPUFREQ
        bool "S3C2450, S3C2443, S3C2412 and S3C2440 DVS CPUFREQ driver"
        depends on (CPU_S3C2412 || CPU_S3C2440 || CPU_S3C2443 || CPU_S3C2450) && (S3C24XX_DFS_CPUFREQ=n) 
	default n
        help
	  This driver adds a CPUFreq driver which uses the Dynamic
	  Voltage Scaling feature present on the above mentioned
	  SOCs. Note that it only has 2 states: Full speed and
	  CPU Clock = Memory Clock.

	  If in doubt, say YES PLEASE :)

config S3C24XX_DFS_CPUFREQ
        bool "S2C2450, S3C2443, S3C2412 DFS CPUFREQ driver"
        depends on (CPU_S3C2412 || CPU_S3C2440 || CPU_S3C2443 || CPU_S3C2450)
	default n
        help
	  This driver adds a CPUFreq driver which uses Dynamic
	  Frequency Scaling on the above mentioned SOCs.
	  This supports a range of frequencies, but does not
	  change only the CPU clock, but MPLL and with it all
	  derived clocks.

	  If in doubt, say Oh god yes I want, I want :)

endif # CPU_FREQ && ARCH_S3C2410

#endmenu
```

## go9/linux-s3c24xx/drivers/barcelona/Kconfig
```kconfig
# drivers/barcelona/Kconfig
# 
# Menuconfig script for Barcelona device configuration.
#
# Copyright (C) 2004,2005 TomTom BV <http://www.tomtom.com/>
# Author: Dimitry Andric <dimitry.andric@tomtom.com>
#
# This program is free software; you can redistribute it and/or modify
# it under the terms of the GNU General Public License version 2 as
# published by the Free Software Foundation.

if MACH_TOMTOMGO

config BARCELONA_ADC
	tristate "ADC driver"

config BARCELONA_ACC
	tristate "(OLD) Accelerometer driver"
	depends on BARCELONA_ADC
	
config BARCELONA_DOCK
	tristate "Barcelona/Liverpool dock driver"
	depends on I2C

config GPRS_INTERFACE
	tristate "GPRS interface for Knock/Murcia"
 
config BARCELONA_GACC_SMB365
	tristate "Bosch SMB365 Accelerometer driver"
	depends on SPI_MASTER && ARCH_S3C2410

config BARCELONA_GACC_KXP74
	tristate "Kionix KX74 series Accelerometer driver"
	depends on SPI_MASTER && ARCH_S3C2410

config BARCELONA_GYRO_FUJITSU
	tristate "Fujitsu Gyro device driver"
	depends on BARCELONA_ADC

config BARCELONA_GYRO_ING300
	tristate "InvenSense ING 300 gyro device driver"
	depends on BARCELONA_ADC

config BARCELONA_GADC
	tristate "New generic ADC interface (replaces BARCELONA_GYRO_FUJITSU and BARCELONA_GYRO_ING300)"
	depends on BARCELONA_ADC

config BARCELONA_BARO
	tristate "Barometer driver"
	depends on BARCELONA_GADC

config BARCELONA_GADC_KXR94
	tristate "KXR94 Accelerometer GADC driver"
	depends on BARCELONA_GADC

config BARCELONA_BAT
	tristate "Battery driver"
	depends on BARCELONA_ADC && BARCELONA_USBMODE

config BARCELONA_TS
	tristate "Touch screen driver"
	depends on BARCELONA_ADC

config BARCELONA_TSINPUT
	tristate "Touch screen input driver"
	depends on BARCELONA_ADC

config BARCELONA_BUSPOWER
	tristate "bus power driver"

config BARCELONA_GPIO
	tristate "GPIO driver"
	depends on BARCELONA_ADC && BARCELONA_BUSPOWER

config BARCELONA_GPS
	tristate "GPS driver"

config BARCELONA_HW
	tristate "Hardware detection driver"

config BARCELONA_USBMODE
	tristate "Legacy USB mode detect and set"

config BARCELONA_USBMODE_S3C24XX
        depends on BARCELONA_USBMODE && ARCH_S3C2410 && BARCELONA_BUSPOWER
        tristate "Legacy USB mode detect and set s3c24xx implementation"

config BARCELONA_PWM
	tristate "PWM (LCD backlight) driver"
	depends on BARCELONA_ADC

config BARCELONA_SOUND
	tristate "Sound driver"
	depends on BARCELONA_GPIO

config BARCELONA_SOUND_FILTER
	depends on BARCELONA_SOUND
	tristate "Sound driver filter API"

config BARCELONA_SOUND_ALC5628
	depends on I2C
	tristate "Realtek ALC5628 audio codec (I2C)"

config BARCELONA_RC
	tristate "Remote control"

config BARCELONA_BUZ
	tristate "Buzzer driver"

config BARCELONA_LTC3455
	tristate "LTC3455 PMIC Driver"
	help
	  Implementation for the LTC3455 PMIC IC, using GPIO to control states. This
	  is currently only implemented on Milan and deratives.
	  Just say Y.

config BARCELONA_EXTERNAL_UART
	tristate "Support external UART"
	select SERIAL_8250
	help
	  Some GO versions have an extra 8250/16550 compatible UART beside the ones on the SOC. 
	  Say Y here if you want support for it.

config BARCELONA_SOCSRAM
	tristate "S3C24XX 4KB SRAM support"

endif # MACH_TOMTOMGO

# EOF
```

## go9/linux-s3c24xx/drivers/mmc/Kconfig
```kconfig
#
# MMC subsystem configuration
#

menuconfig MMC
	tristate "MMC/SD card support"
	help
	  MMC is the "multi-media card" bus protocol.

	  If you want MMC support, you should say Y here and also
	  to the specific driver for your MMC interface.

config MMC_8_BIT_TRANSFERS
	bool "MMC 8 bit transfer support"
	depends on MMC != n
	help
	  Enable this option to let MMC (Only MMC! Not SD) work in 8 bit mode."

config MMC_PREDEFINED_TRANSFER
	bool "MMC Predefined transfermode"
	depends on MMC != n
	help
	  Enable this option to issue CMD23 before any multiread or multiwrite
	  transfer.

config MMC_DEBUG
	bool "MMC debugging"
	depends on MMC != n
	help
	  This is an option for use by developers; most people should
	  say N here.  This enables MMC core and driver debugging.

if MMC

source "drivers/mmc/core/Kconfig"

source "drivers/mmc/card/Kconfig"

source "drivers/mmc/host/Kconfig"

endif # MMC
```
