## go12/linux-2.6.28.10/drivers/media/video/samsung/tv20/Kconfig
```kconfig
#
# Configuration for Post Porcessor
#

config VIDEO_TV20
	bool "Samsung TV Driver for s5pc1xx" 
	depends on VIDEO_SAMSUNG && CPU_S5PC100
	default n
	---help---
	  This is a TV driver for Samsung SMDK_S5PC100
```

## go12/linux-2.6.28.10/drivers/net/wireless/dhd/Kconfig
```kconfig
config DHD
	tristate "Broadcom BCM4325 wireless chipset support"
	depends on WLAN_80211 && EXPERIMENTAL
	---help---
	  This module adds support for wireless adapter based on
	  Broadcom BCM4325 chipset

	  If you choose to build a module, it'll be called dhd. Say M if
	  unsure.
```

## go12/linux-2.6.28.10/drivers/pmu/Kconfig
```kconfig
menuconfig PMU_DEVICE
	bool "Power Management Devices"
	default n
	help
	  Generic Power Management Unit Support.
	  
	  This framework is designed to provide generic support for Power
	  Management Devices. Typical PMUs consist of components such
	  as LDOs, regulators, Real-time Clocks, GPIOs, battery and
	  battery charger control and status, and potentially many
	  other components.
	  
	  Generally systems only have a single PMU but more complex
	  system configurations may include multiple PMUs. The framework
	  is designed to support single and multiple PMU system architectures
	  ultimately.

if PMU_DEVICE

config PMU_DEVICE_BCM59040
	bool "Broadcom BCM59040 Power Management Unit"
	depends on PMU_DEVICE
	default n
	help
	  Add support for Broadcom BCM59040 PMU_DEVICE

config PMU_DEVICE_BCM59040_RTC
	bool "Broadcom BCM59040 Power Management Unit Real-time Clock"
	depends on PMU_DEVICE_BCM59040
	default n
	help
	  Add support for Broadcom BCM59040 PMU device's real-time clock.

config PMU_DEVICE_BCM59002
	bool "Broadcom BCM59002 Power Management Unit"
	depends on PMU_DEVICE
	default n
	help
	  Add support for Broadcom BCM59002 PMU_DEVICE

config PMU_DEVICE_BCM59002_RTC
	bool "Broadcom BCM59002 Power Management Unit Real-time Clock"
	depends on PMU_DEVICE_BCM59002
	default n
	help
	  Add support for Broadcom BCM59002 PMU device's real-time clock.

endif
```

## go12/linux-2.6.28.10/drivers/tomtom/Kconfig
```kconfig
# drivers/tomtom/Kconfig
#
# Copyright (C) 2008 TomTom BV <http://www.tomtom.com/>
# Author: Kees Jongenburger <kees.jongenburger@tomtom.com>
# Author: Vincent Ruitenberg <Vincent.Rui@tomtom.com>
# Author: Niels Langendorff <niels.langendorff@tomtom.com>
#
# This program is free software; you can redistribute it and/or modify
# it under the terms of the GNU General Public License version 2 as
# published by the Free Software Foundation.

menu "TomTom specific drivers"

config TOMTOM_DRIVERS
	bool "Enable TomTom specific drivers."
	default y
	depends on PLAT_TOMTOM
	help
	  The TomTom specific drivers in the kernel perform
	  functions only useful on TomTom hardware.

config TOMTOM_MEM
	tristate "Enable /dev/mem protection."
	default m
	depends on PLAT_TOMTOM && STRICT_DEVMEM
	

config TOMTOM_BLUETOOTH_MODE
	tristate "Bluetooth mode driver via sysfs"
	depends on SYSFS && TOMTOM_DRIVERS
	default n
	help
	  This is a cleanroom implementation of the extensions that used to reside in the
	  GPIO driver in the Barcelona era. Via sysfs this driver can be used to signal
	  the bluetooth chip to switch to a specific mode and to reset it.

config TOMTOM_FACTORYDATA_EXPORT_DRIVER
	tristate "Build module for exporting factory data through sysfs"
	default m
	depends on SYSFS && TOMTOM_DRIVERS && TOMTOM_FACTORYDATA 
	help
	  TomTom specific driver that exports the factory data 
	  to a sysfs file tree.

config TOMTOM_FDTEXPORT
	tristate "Build module for exporting fdt binary blob through a device"
	default m
	depends on TOMTOM_DRIVERS && TOMTOM_FDT
	help
	  TomTom specific driver that exports the flattened device-tree
	  through a char device.

config TOMTOM_FLIPFLOP
	tristate "FlipFlop driver"
	default m
	depends on TOMTOM_DRIVERS
	help
	  TomTom specific flipflop driver.

config TOMTOM_FLIPFLOP_HW
	tristate "FlipFlop driver / HW implementation"
	default n
	depends on TOMTOM_DRIVERS
	help
	  Flip-flop driver using real HW. Temporary option.

config TOMTOM_ACTIVE_DOCK
	tristate "Support for TomTom Active Dock"
	default m
	depends on TOMTOM_DRIVERS
	help
	  Implements support for Active Docks as used for Cagliari & later.

config TOMTOM_SI4711
	tristate "Support for SI4711 FM transmitter"
	default m
	depends on TOMTOM_DRIVERS
	help
	  Enable support for TomTom SI4711 FM transmitter

config TOMTOM_GADC
	bool "Support for General ADC"
	default y
	depends on TOMTOM_DRIVERS
	help
	  Enable support for TomTom General ADC

config TOMTOM_GADC_TITAN2
	tristate "Support for General ADC for Titan2 ADC"
	default m
	depends on ARCH_SIRFSOC && TOMTOM_GADC
	help
	  Enable support for Titan2 ADC using GADC

config TOMTOM_GADC_GENERIC
	tristate "Support for General ADC Generic"
	default m
	depends on TOMTOM_GADC
	help
	  Enable support for Generic implementation of the ADC user interface driver

config TOMTOM_EWTS98
	tristate "Support for EWTS98 angular rate sensor"
	default y
	depends on TOMTOM_DRIVERS
	help
	  Enable support for TomTom EWTS98 angular rate sensor

config TOMTOM_SCP1000
	tristate "Support for SCP1000 pressure sensor"
	default y
	depends on TOMTOM_DRIVERS && TOMTOM_GADC
	help
	  Enable support for TomTom SCP1000 pressure sensor

config TOMTOM_KXR94
	tristate "Support for KXR94 accelerometer sensor"
	default y
	depends on TOMTOM_DRIVERS && TOMTOM_GADC && SPI
	help
	  Enable support for TomTom KXR94 accelerometer sensor

config TOMTOM_PB
	bool "Support for power button"
	default y
	depends on TOMTOM_DRIVERS && APM_EMULATION
	help
	  Enable support for TomTom power button

config TOMTOM_TPS851
	tristate "Support TPS851 ADC lightsensor"
	default m
	depends on TOMTOM_DRIVERS
	help
	  Enable support for TPS851 Lightsensor

config TOMTOM_USBMODE
	tristate "Legacy USB mode detect and set"
	depends on TOMTOM_DRIVERS
	default n
	help
	  This option enables the TomTom specific USB
	  mode switching between usb host and function

config TOMTOM_USBMODE_DUMMY
	tristate "Legacy USB mode detect and set dummy implementation"
	depends on TOMTOM_USBMODE && TOMTOM_DRIVERS
	default n
	help
	  This is a dummy low-level usbmode driver which allows usbmode events
	  to be forced through sysfs. Does not interact with USB hardware.

config TOMTOM_USBMODE_SIRFSOC
	tristate "Legacy USB mode detect and set implementation for sirfsoc"
	depends on TOMTOM_USBMODE &&  TOMTOM_DRIVERS && ARCH_SIRFSOC
	default y if ARCH_SIRFSOC

config TOMTOM_USBMODE_S3C64XX
	tristate "Legacy USB mode detect and set implementation for s3c64xx"
	depends on TOMTOM_USBMODE &&  TOMTOM_DRIVERS && TOMTOM_VBUSMON && PLAT_S3C64XX
	default y if PLAT_S3C64XX

config TOMTOM_USBMODE_SYNAP_LL_LIGHT
	tristate "Legacy USB mode detect and set implementation for Synaptics OTG core devices"
	depends on TOMTOM_USBMODE &&  TOMTOM_DRIVERS && TOMTOM_VBUSMON && (ARCH_BCM4760 || PLAT_S3C64XX || PLAT_MENDOZA)
	default y if (ARCH_BCM4760 || PLAT_MENDOZA)
	help
	  This option enables USBMode support for Synaptics OTG core devices.

config TOMTOM_VBUSMON
	tristate "Legacy USB vbus detect"
	depends on TOMTOM_DRIVERS && (PLAT_MENDOZA || ARCH_BCM4760)
	default y
	help
	  This driver enables an interrupt on the USB vbus power, connected
	  via a GPIO pin.

config TOMTOM_GPIO_VBUSMON
    bool "Legacy USB vbus detect using gpio and interrupt"
    depends on TOMTOM_VBUSMON && (PLAT_MENDOZA || ARCH_BCM4760)
    default y
    help
      This driver enables an interrupt on the USB vbus power, connected
      via a GPIO pin.

config TOMTOM_SI4703
	tristate "Support for SI4703 RDS/TMC receiver"
	default m
	depends on I2C && TOMTOM_DRIVERS && TOMTOM_ACTIVE_DOCK
	help
	  Enable support for the TomTom SI4703 FM receiver.

config TOMTOM_VBUSMON_BCM59040_USBSTAT
	tristate "BCM59040 USBSTAT Override VBus / Host / Device detection workaround"
	depends on TOMTOM_VBUSMON && PMU_DEVICE_BCM59040 && ARCH_BCM4760
	default y if ARCH_BCM4760
	help
	  This implementation works around the problem where either the USBSTAT lines, the PMU_ID_OUT line or both are missing.
	  The VBUS/Host/Device mode detection comes from PMU interrupts and requires the PMU bus implementation.

config TOMTOM_LOW_DC_VCC
	tristate "Support for the low battery Voltage detector (LOW_DC_VCC)"
	default n
	depends on TOMTOM_DRIVERS
	help
	  Enable detection of low_dc_vcc which lets the unit suspend if detected.

config TOMTOM_USBMODE_QUICKCHANGES
    bool
	depends on TOMTOM_VBUSMON && TOMTOM_USBMODE
	default n
	help
	  Hack for USBMODE to work on Samsung platforms. This is needed when switching usbmode states takes a long time
	  relative to the change rate of the VBUS.

config TOMTOM_PPS_DRIVER
	default n
	depends on TOMTOM_DRIVERS && PPS && ARCH_BCM4760
	tristate "PPS driver"
	help
	  Provides support for 1PPS (Pulse-Per-Second) through the LinuxPPS subsystem.

config TOMTOM_TILT_TS0001_L
	tristate "Tilt sensor driver for TS0001-L"
	default n
	depends on TOMTOM_DRIVERS
	help
	  Enable detection of tilt.

config TOMTOM_TILT_TS1003_AL
	tristate "Tilt sensor driver for TS1003-AL"
	default n
	depends on TOMTOM_DRIVERS
	help
	  Enable detection of 2-axis tilt.
	  
config TOMTOM_DEBUG_KERNEL
	bool "Disable signed loop security"
	default n
	depends on TOMTOM_DRIVERS
	help
	  When set signed loop security is disabled to support a debug kernel, however it should
	  always be unset since the kernel.ttbld will automatically set it when building zImage.debug!

source "drivers/tomtom/gprs/Kconfig"

source "drivers/tomtom/gps/Kconfig"

source "drivers/tomtom/pmic/Kconfig"

source "drivers/tomtom/battery/Kconfig"

source "drivers/tomtom/sound/Kconfig"

source "drivers/tomtom/idpinmon/Kconfig"

source "drivers/tomtom/lcm/Kconfig"

endmenu
```

## go12/linux-2.6.28.10/drivers/tomtom/lcm/Kconfig
```kconfig
# drivers/tomtom/lcm/Kconfig
#
# Copyright (C) 2012 TomTom BV <http://www.tomtom.com/>
# Author: Will Lin <Will.Lin@tomtom.com>
#
# This program is free software; you can redistribute it and/or modify
# it under the terms of the GNU General Public License version 2 as
# published by the Free Software Foundation.

menuconfig TOMTOM_LCM
	default y
	depends on TOMTOM_DRIVERS
	bool "TomTom LCM drivers"
	---help---
          This option enables support for LCM.

if TOMTOM_LCM

config TOMTOM_LCM_LMS606KF01
	tristate "Enable LMS606KF01 support"
	default m
	depends on SPI
	help
	  Support for LMS606KF01 LCM.

endif # TOMTOM_HDR
```

## go12/linux-2.6.28.10/drivers/tomtom/sound/Kconfig
```kconfig
# drivers/tomtom/sound/Kconfig
#
# Copyright (C) 2009 TomTom BV <http://www.tomtom.com/>
# Author: Niels Langendorff <niels.langendorff@tomtom.com>
#
# This program is free software; you can redistribute it and/or modify
# it under the terms of the GNU General Public License version 2 as
# published by the Free Software Foundation.

menuconfig TOMTOM_NASHVILLE
	default n
	depends on TOMTOM_DRIVERS
	bool "TomTom Nashville drivers"
	---help---
          This option enables support for Nashville.


if TOMTOM_NASHVILLE

config TOMTOM_NASHVILLE_SCENARI
	bool "Nashville scenari system"
	depends on TOMTOM_DRIVERS && (PLAT_BCM476X || MACH_CORDOBA || MACH_TORINOS || MACH_SEOUL || MACH_LIMA || MACH_HAVANA || MACH_VENICE || MACH_CATANIA_S)
	default y
	help
	  Enable the nashville senari subsystem

config TOMTOM_NASHVILLE_SCENARI_DUMMY
	bool "Dummy handler"
 	depends on TOMTOM_NASHVILLE_SCENARI
	help
	  The default choice if you don't have a platform specific handler yet.

config TOMTOM_NASHVILLE_SCENARI_WM8990
	bool "WM8990 handler"
 	depends on TOMTOM_NASHVILLE_SCENARI
	depends on SND_SOC_WM8990
	help
	  Handler for the WM8990 codec.

config TOMTOM_NASHVILLE_SCENARI_ADAU1761
	bool "ADAU1761 handler"
 	depends on TOMTOM_NASHVILLE_SCENARI
	depends on SND_SOC_ADAU1761
	help
	  Handler for the Analog devices 1761 codec.

config TOMTOM_NASHVILLE_SCENARI_BCM4760
	bool "Broadcom Bcm4760 handler"
 	depends on TOMTOM_NASHVILLE_SCENARI
	depends on SND_BCM476X_SOC_INTERNAL
	help
	  Handler for the Broadcom 4760 codec.

config TOMTOM_NASHVILLE_SCENARI_S5M8751
	bool "S5M8751 handler"
 	depends on TOMTOM_NASHVILLE_SCENARI
	depends on SND_SOC_S5M8751
	help
	  Handler for the Samsung S5M8751 codec.

config TOMTOM_NASHVILLE_SCENARI_TLV320ADC3101
	bool "TLV320ADC3101 handler"
 	depends on TOMTOM_NASHVILLE_SCENARI
	depends on SND_SOC_TLV320ADC3101
	help
	  Handler for the Texas Instruments TLV320ADC3101 codec.

endif # TOMTOM_NASHVILLE
```

## go12/linux-2.6.28.10/kernel/Kconfig.cpuisol
```kconfig
config CPUISOL
	depends on SMP
	bool "CPU isolation"
	help
	  This option enables support for CPU isolation. If enabled the
	  kernel will try to avoid kernel activity on the isolated CPUs.
	  By default user-space threads are not scheduled on the isolated
	  CPUs unless they explicitly request it via sched_setaffinity()
	  and pthread_setaffinity_np() calls. Isolated CPUs are not
	  subject to the scheduler load-balancing algorithms.

	  This feature is useful for hard realtime and high performance
	  applications.
	  See Documentation/cpu-isolation.txt for more details.

	  If unsure say 'N'.

config CPUISOL_WORKQUEUE
	bool "Do not schedule workqueues on the isolated CPUs (EXPERIMENTAL)"
	depends on CPUISOL && EXPERIMENTAL
	help
	  If this option is enabled kernel will not schedule workqueues on
	  the isolated CPUs.  Please note that at this point this feature
	  is experimental. It breaks certain things like OProfile that
	  heavily rely on per cpu workqueues.

	  Say 'Y' to enable workqueue isolation.  If unsure say 'N'.

config CPUISOL_STOPMACHINE
	bool "Do not halt isolated CPUs with Stop Machine (EXPERIMENTAL)"
	depends on CPUISOL && STOP_MACHINE && EXPERIMENTAL
	help
	  If this option is enabled kernel will not halt isolated CPUs
	  when Stop Machine is triggered. Stop Machine is currently only
	  used by the module insertion and removal.
	  Please note that at this point this feature is experimental. It is 
	  not known to really break anything but can potentially introduce
	  an instability due to race conditions in module removal logic.

	  Say 'Y' if support for dynamic module insertion and removal is
	  required for the system that uses isolated CPUs. 
	  If unsure say 'N'.
```

## go12/linux-2.6.28.10/kernel/Kconfig.custom-stack
```kconfig
config CUSTOM_STACK
	bool "Enable custom stack sizes"
	depends on BROADCOM_BCM1103
	default n
	help
	  If you say Y here, then custom stack sizes will be enabled.

config CUSTOM_STACK_DEFAULT_ORDER
    int "Default stack size order"
    depends on CUSTOM_STACK
    default 1
    help
        This sets the "order" of the default stack size. The default stack size will
        be PAGE_SIZE << order. A value of 1 with 4k pages equates to 8k stack.
        
config CUSTOM_STACK_BIG_ORDER
    int "Big stack size order"
    depends on CUSTOM_STACK
    default 2
    help
        This sets the "order" of the big stack size. The big stack size will
        be PAGE_SIZE << order. A value of 2 with 4k pages equates to a 16k big stack.
        Threads created with the CLONE_BIG_STACK flag will get a stack using
        this stack size.
```
