## go12/linux-2.6.28.10/arch/arm/mach-s5pc110/Kconfig
```kconfig
# arch/arm/mach-s5pc110/Kconfig
#
# Copyright 2008 Openmoko, Inc.
# Copyright 2008 Simtec Electronics
#
# Licensed under GPLv2

# Configuration options for the S5PC110 CPU

config CPU_S5PC110
	bool
	select CPU_S5PC110_INIT
	select CPU_S5PC110_CLOCK
	help
	  Enable S5PC110 CPU support

config S5PC1XX_SETUP_SDHCI
        bool
        help
          Internal helper functions for S5PC1XX based SDHCI systems

config S5PC110_PM
	bool "S5PC110 PM Support"
	depends on PM && CPU_S5PC110
	help
	  Internal config node to apply S5PC110 power management

config MACH_SMDKC110
	bool "SMDKC110"
	select CPU_S5PC110
	select S3C_DMA_PL330
	select S3C_DEV_I2C1
        select S3C_DEV_HSMMC
        select S3C_DEV_HSMMC1
        select S5PC1XX_SETUP_SDHCI
	select S3C64XX_SETUP_I2C1
	help
	  Machine support for the Samsung SMDKC110
```

## go12/linux-2.6.28.10/arch/arm/plat-s3c64xx/Kconfig
```kconfig
# arch/arm/plat-s3c64xx/Kconfig
#
# Copyright 2008 Openmoko, Inc.
# Copyright 2008 Simtec Electronics
#	Ben Dooks <ben@simtec.co.uk>
#
# Licensed under GPLv2

config PLAT_S3C64XX
	bool
	depends on ARCH_S3C64XX
	select PLAT_S3C
	select ARM_VIC
	default y
	select NO_IOPORT
	select ARCH_REQUIRE_GPIOLIB
	select S3C_GPIO_TRACK
	select S3C_GPIO_PULL_UPDOWN
	select S3C_GPIO_CFG_S3C24XX
	select S3C_GPIO_CFG_S3C64XX
	select DMABOUNCE
	help
	  Base platform code for any Samsung S3C64XX device

if PLAT_S3C64XX

# Configuration options shared by all S3C64XX implementations

config CPU_S3C6400_INIT
	bool
	help
	  Common initialisation code for the S3C6400 that is shared
	  by other CPUs in the series, such as the S3C6410.

config CPU_S3C6400_CLOCK
	bool
	help
	  Common clock support code for the S3C6400 that is shared
	  by other CPUs in the series, such as the S3C6410.

config S3C64XX_DMA
	bool "S3C64XX DMA"
	select S3C_DMA
	default y

# platform specific device setup

config S3C64XX_SETUP_I2C0
	bool
	default y
	help
	  Common setup code for i2c bus 0.

	  Note, currently since i2c0 is always compiled, this setup helper
	  is always compiled with it.

config S3C64XX_SETUP_I2C1
	bool
	help
	  Common setup code for i2c bus 1.

config S3C64XX_ADC
	bool "S3C64XX ADC D/D support"
	help
	 Analog to Digital conversion(ADC) D/D for S3C64XX support   

config S3C64XX_DEV_FIMC0
	bool
	default y
	help
	  Compile in platform device definitions for FIMC controller 0

config S3C64XX_DEV_FIMC1
	bool
	default y
	help
	  Compile in platform device definitions for FIMC controller 1

config S3C64XX_SETUP_FIMC0
	bool
	default y
	help
	  Common setup code for FIMC controller 0

config S3C64XX_SETUP_FIMC1
	bool
	default y
	help
	  Common setup code for FIMC controller 1

# FB part
config S3C64XX_DEV_FB
	bool
	depends on FB_S3C_V2
	default y
	help
	  Compile in platform device definitions for FIMD controller

config S3C64XX_SETUP_FB
	bool "SMDK specific setup code for FIMD controller"
	depends on FB_S3C_V2
	default y
	help
	  Common setup code for FIMD controller.

config S3C64XX_DEV_RP
	bool
	default y
	help
	  Compile in platform device definitions for Renderer pipeline

config S3C_PWM
	bool "S3C PWM support"
	select HAVE_PWM
	help
	  Support for exporting the PWM timer blocks via the pwm device system.

endif
```

## go12/linux-2.6.28.10/arch/arm/plat-s5p64xx/Kconfig
```kconfig
# arch/arm/plat-s5p64xx/Kconfig
#
# Copyright 2008 Openmoko, Inc.
# Copyright 2008 Simtec Electronics
#	Ben Dooks <ben@simtec.co.uk>
#
# Licensed under GPLv2

config PLAT_S5P64XX
	bool
	depends on ARCH_S5P64XX
	select PLAT_S3C
	select ARM_VIC
	default y
	select NO_IOPORT
	select ARCH_REQUIRE_GPIOLIB
	select S3C_GPIO_TRACK
	select S3C_GPIO_PULL_UPDOWN
	select S3C_GPIO_CFG_S3C24XX
	select S3C_GPIO_CFG_S3C64XX
	help
	  Base platform code for any Samsung S5P64XX device

if PLAT_S5P64XX

# Configuration options shared by all S5P64XX implementations

config CPU_S5P6440_INIT
	bool
	help
	  Initialisation code for the S5P6440. 

config CPU_S5P6440_CLOCK
	bool
	help
	  Clock support code for the S5P6440.

# platform specific device setup

config S5P64XX_SETUP_I2C0
	bool
	default y
	help
	  Common setup code for i2c bus 0.

	  Note, currently since i2c0 is always compiled, this setup helper
	  is always compiled with it.

config S5P64XX_SETUP_I2C1
	bool
	help
	  Common setup code for i2c bus 1.

# FB part
config S5P64XX_DEV_FB
	bool
	depends on FB_S3C_V2
	default y
	help
	  Compile in platform device definitions for FIMD controller

config S5P64XX_SETUP_FB
	bool
	depends on FB_S3C_V2
	default y
	help
	  Common setup code for FIMD controller.

config S5P64XX_ADC
        bool "S5P64XX ADC D/D support"
        help
         Analog to Digital conversion(ADC) D/D for S5P64XX support

config S3C_PWM
	bool "S3C PWM support"
	select HAVE_PWM
	help
	  Support for exporting the PWM timer blocks via the pwm device system.

choice
	prompt "Voltage Control Device"
	depends on CPU_FREQ
	default	S5P64XX_LTC3714
	help
	 Select voltage control device for DVFS

	config S5P64XX_LTC3714
		bool "LTC3714 voltage regulator support"

	config S5P6440_S5M8751
		select MFD_S5M8751_I2C
		bool "S5M8751 device support"
endchoice
  
endif
```

## go12/linux-2.6.28.10/arch/arm/plat-tomtom/Kconfig
```kconfig
menu "TomTom Platform options"

config PLAT_MENDOZA
	bool
	help
	  Internal helper for Mendoza carrier board, directly selected
	  by the usual suspects.

config PLAT_IRVINE
	bool
	help
	  Macros and function that are specific to the Irvine platform.

config TOMTOM_HAVE_SERIAL_BARRACUDA
	bool

config TOMTOM_HAVE_SPI_BARRACUDA
	bool

config TOMTOM_HAVE_SERIAL_AR15XX
	bool

config PLAT_TOMTOM
	bool "Enable TomTom platforms specific features"
	default n
	help
	  Enable the TomTom platform generic features. If unsure what to say here, 
	  "No" is a very good choice.

config TOMTOM_FDT
	bool "Enable fdt (flattened device-tree) use (library, export driver)"
	depends on PLAT_TOMTOM
	default y
	help
	  Select this option for selecting fdt device-tree parsing
	  from u-boot. Need u-boot support for it.

config TOMTOM_TT_SETUP
	bool "Enable the TomTom setup handler"
	depends on PLAT_TOMTOM
	default y
	help
	  Select this option to enable the TomTom specific tt_setup methods.
          If CONFIG_TOMTOM_FDT is not available, add ALL tt_setup-registered
	  platform-devices by default.

config STRICT_DEVMEM
        bool "Filter access to /dev/mem"
	default y

config SIGN_ZIMAGE
	bool "Sign the created zImage using the TomTom DSA key"
	depends on PLAT_TOMTOM
	default y

source "drivers/tomtom/Kconfig"
endmenu
```

## go12/linux-2.6.28.10/drivers/char/broadcom/Kconfig
```kconfig
#
# Miscellaneous Broadcom device configuration
#

config BCM_DEBUG_PAUSE
    bool
    default n

config BCM_HAVE_PROC_GPIO
    bool
    help
       Platforms select HAVE_PROC_GPIO if they want the /proc/sys/gpio directory to
       show up.

menu "Broadcom Miscellaneous Devices"

config BCM_LCD_BACKLIGHT
    bool "LCD Backlight Support"
    default n

config BCM_HALAUDIO_HOOK
    bool "HAL Audio Hook Driver"
    default y
    ---help---
    This driver provides a HAL audio hook to work with ALSA and Endpoint.

config BCM_EPTDRIVER_SUPPORT
    bool "Endpoint Driver Support"
    default y
    depends on BCM_HALAUDIO_HOOK
    ---help---
    Endpoint Driver kernel support patches, requires network support.

config BCM_HALAUDIO_PLATFORM
    bool "HAL Audio Platform support"
    default y
    ---help---
    Choose to enable HAL Audio platform support which is required to run HAL Audio.
    Platform support includes platform specific items such as toggling GPIOs to 
    enable an external op-amp for a loud speaker. 

choice
    prompt "External Codec Support"
    default BCM_HALAUDIO_NOEXTERNAL
    depends on BCM_HALAUDIO_HOOK
    ---help---
    Choose the type of development platform that the kernel is being built for

config BCM_HALAUDIO_NOEXTERNAL
    bool "No External Codec"
    ---help---
    No external codec.

config BCM_HALAUDIO_CUSTOM
    bool "Custom External Codec"
    ---help---
    Custom external codec.

config BCM_HALAUDIO_AK4642
    bool "AK4642 support"
    ---help---
    Reference wideband phone board that supports the AK4642 external codec.

config BCM_HALAUDIO_AK4642_I2C_TEST
    bool "AK4642 I2C test"
    depends on BCM_HALAUDIO_AK4642
    ---help---
    I2C test using the AK4642 external codec.

config BCM_HALAUDIO_BCM911XXAPMHSS
    bool "BCM911XXAPMHSS support"
    depends on MIPS
    ---help---
    Selects support for BCM911xx APM and HSS reference boards. An example
    board that uses this is the BCM91103EVM.

endchoice

config BCM_ADC_DRIVER
	bool "BCM-bridge ADC Driver"
	default y
	---help---
	This driver provides a generic interface for the 4760 and 59040 ADC drivers.

config BCM4760_ADC_DRIVER
	bool "BCM4760 ADC Driver"
	default y
	---help---
	This driver provides a low level interface for the 4760 ADC that is used by
	the BCM_ADC driver.

config BCM_HALAUDIO_MIXER
    bool "HAL Audio Mixer"
    default n
    ---help---
    This driver provides flexibility to route audio samples to different destination.

config BCM_IODUMP_SUPPORT
    bool "IO Dump Debugging"
    default y
    ---help---
    IO Dump debugging to capture media packets, PCM data, system logs, etc.

config BCM_PERFCNT_SUPPORT
    bool "Hardware Performance Counter Support"
    default y
    ---help---
    perfcnt is a simplified hardware performance counter interface for mips32 and arm11 chips.

config BCM_BUS_ARBITER
    bool "Programmable Bus Arbiter (HPM)"
    default y
    ---help---
    Enable a simple proc/sys interface to program the arm11 HPM.

config BCM_PMU
    bool "PMU Chip Support"
    default y
    ---help---
    Support for Power Management Chips

config BCM_PMU_BCM59001
    bool "BCM59001 PMU Support"
    default n
    depends on BCM_PMU
    depends on I2C
    ---help---
    Support for the BCM59001 Power Management Chip

config BCM_PMU_BCM59035_B0
    bool "BCM59035_B0 PMU Support"
    default n
    depends on BCM_PMU
    depends on I2C
    ---help---
    Support for the BCM59035_B0 Power Management Chip

config BCM_PMU_BCM59040
    bool "BCM59040 PMU Support"
    default n
    depends on BCM_PMU
    depends on I2C
    ---help---
    Support for the BCM59040 Power Management Chip
config BCM_PMU_BCM59040_B0
    bool "BCM59040 B0 PMU Support"
    default n
    depends on BCM_PMU_BCM59040
    ---help---
    Support for B0 revision of the BCM59040 Power Management Chip. Note that if this option is enabled, A0 revision will not work!

config BCM_PMU_PCF506XX
    bool "PCF506XX PMU Support"
    default n
    depends on BCM_PMU
    depends on I2C
    ---help---
    Support for the PCF50603 and PCF50611 Power Management Chips

config BCM_POWER_MANAGER
    bool "Power Manager"
    default y
    depends on BCM_PMU
    ---help---
    Include the Power Manager.

config BCM_BATTERY_MANAGER
    bool "Battery Manager"
    default n
    depends on BCM_POWER_MANAGER
    ---help---
    Include the Battery Management portion of Power Manager.

config BCM_VC02
    bool "VC02 Driver"
    select BCM_LCD_BACKLIGHT
    ---help---
    Say Y if you have a VC02 (VideoCore) attached to the host

config BCM_DEBUG_PAUSE_VC
    bool "Wait for a keypress during boot - VideoCore"
    select BCM_DEBUG_PAUSE
    depends on BCM_VC02
    help
      Allows the kernel to pause prior to bootloading the VideoCore processor.
      This is a convenient place to break in order to load the VideoCore JTAG.

config BCM_VC03
    bool "VC03 Driver"
    ---help---
    Say Y if you have a VC03 VideoCore3 attached to the host

config BCM_VC03B0
    bool "VC03B0 Driver"
    ---help---
    Say Y if you have a VC03B0 VideoCore3 attached to the host

config BCM_VIDEOCORE_TARGET
    string "VC02 VideoCore Target"
    default ""
    depends on BCM_VC02
    ---help---
    Select VC02 VideoCore Target.

config BCM_LCD_PERF
    bool "Display CPU stats on bottom of LCD"
    ---help---
    Say Y to cause the bottom two scan lines of the LCD to be used for displaying
    a CPU performance meter.

config BCM_IDLE_PROFILER_SUPPORT
    bool "Enable idle cycles profiling"
    depends on ARCH_BCM116X || BROADCOM_BCM1103 || ARCH_BCMRING
    default y
    help
      Maintain a counter of ticks spent in idle state.

config BCM_SLEEP_MODE
    bool "Sleep Mode Control"
    depends on ARCH_BCM116X
    ---help---
    Include the Sleep Mode Control

config BCM_RELTIME
    bool "RelTime Driver"
    ---help---
    This driver provides a relative timestamp based on the jiffie counter.
    select LCD_API

config BCM_OTP
    tristate "OTP Driver"
    ---help---
    This driver provides access to the One-Time Programmable (OTP) memory.

config BCM_GPIO_DRIVER
     tristate "GPIO driver"
     default y
     ---help---
     This driver allows user mode program to get access to GPIO pins.

config BCM_4325_DRIVER
     tristate "BCM4325 Initialization Driver"
     default n
     ---help---
     This sets up the GPIOs for Wireless LAN and Bluetooth in BCM4325.

config BCM_DD
     tristate "BCM Display Director Driver"
     default n
     ---help---
     Say Y to enable the BCM Display Director driver 

source "drivers/char/broadcom/userdma/Kconfig"

endmenu
```

## go12/linux-2.6.28.10/drivers/char/broadcom/userdma/Kconfig
```kconfig
config BCM_USERDMA
	 depends on HAS_DMA
     tristate "userdma driver"
     default y
     ---help---
     This driver allows user mode program to get access to hardware DMA.
    
config BCM476X_USERDMA
	bool "BCM476X user dma driver"
	depends on BCM_USERDMA && PLAT_BCM476X
	default y	
	help
	  Broadcom BCM476X user dma interface.
```

## go12/linux-2.6.28.10/drivers/media/video/samsung/gvg/Kconfig
```kconfig
#
# Configuration for FIMG-VG
#

config VIDEO_GVG
	tristate "Samsung FIMG-VG Driver"
	depends on CPU_S5P6440
	default n
	---help---
	  This is a FIMG-VG(OpenVG accelerator) driver for Samsung S5P6440.

choice
        prompt "FIMG-VG memory allocation type"
	depends on VIDEO_GVG
	default VIDEO_GVG_USE_BOOTMEM

config VIDEO_GVG_USE_BOOTMEM
        bool "Use bootmem"
	help
		Use bootmem to allocate the tessellate memroy for FIMG-VG hardware.

config VIDEO_GVG_USE_KMALLOC
        bool "Use kmalloc"
	help
		Use kmalloc to allocate the tessellate memory for FIMG-VG hardware.
endchoice

config VIDEO_GVG_TESSELLATE_EDGE_MEM_SIZE
	depends on VIDEO_GVG
	int "FIMG-VG tessellate edge memory size in kbytes"
	default "2048"

config VIDEO_GVG_TESSELLATE_VERTEX_MEM_SIZE
	depends on VIDEO_GVG
	int "FIMG-VG tessellate vertex memory size in kbytes"
	default "512"

comment "VG resource memory configuration"

config VIDEO_GVG_RESOURCE_MEM_BLOCK_SIZE
	depends on VIDEO_GVG
	int "FIMG-VG resource memory block size in kbytes"
	default "2048"
	help
		The resource memory size to be allocated is
		VIDEO_GVG_RESOURCE_MEM_BLOCK_SIZE * VIDEO_GVG_RESOURCE_MEM_BLOCK_NUM kbytes.

config VIDEO_GVG_RESOURCE_MEM_BLOCK_NUM
	depends on VIDEO_GVG
	int "The number of FIMG-VG resource memory block"
	default "3"
	help
		The resource memory size to be allocated is
		VIDEO_GVG_RESOURCE_MEM_BLOCK_SIZE * VIDEO_GVG_RESOURCE_MEM_BLOCK_NUM kbytes.

config VIDEO_GVG_MEMSIZE_EDGE
	int
	depends on VIDEO_GVG
	default VIDEO_GVG_TESSELLATE_EDGE_MEM_SIZE

config VIDEO_GVG_MEMSIZE_VERTEX
	int
	depends on VIDEO_GVG
	default VIDEO_GVG_TESSELLATE_VERTEX_MEM_SIZE
		
```

## go12/linux-2.6.28.10/drivers/media/video/samsung/rp/Kconfig
```kconfig
#
# Configuration for renderer pipeline
#

config VIDEO_RP
	bool "Samsung Renderer pipeline Driver" 
	depends on VIDEO_SAMSUNG && (VIDEO_ROTATOR != y) && (VIDEO_POST != y) && (CPU_S3C6410)
	default n
	---help---
	  This is a Renderer pipeline for Samsung S3C6410.

config VIDEO_RP_DEBUG
        bool "Samsung Renderer pipeline driver debug messages"
        depends on VIDEO_RP
	  
```
