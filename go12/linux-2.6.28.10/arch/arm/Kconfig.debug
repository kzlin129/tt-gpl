## go12/linux-2.6.28.10/lib/Kconfig.kgdb
```kconfig
config HAVE_ARCH_KGDB
	bool

menuconfig KGDB
	bool "KGDB: kernel debugging with remote gdb"
	depends on HAVE_ARCH_KGDB
	depends on DEBUG_KERNEL && EXPERIMENTAL
	help
	  If you say Y here, it will be possible to remotely debug the
	  kernel using gdb.  It is recommended but not required, that
	  you also turn on the kernel config option
	  CONFIG_FRAME_POINTER to aid in producing more reliable stack
	  backtraces in the external debugger.  Documentation of
	  kernel debugger is available at http://kgdb.sourceforge.net
	  as well as in DocBook form in Documentation/DocBook/.  If
	  unsure, say N.

if KGDB

config KGDB_MODULES
	bool "KGDB: Debug modules without KALLSYMS"
	depends on KGDB && !KALLSYMS && SYSFS
	default y
	help
	  This option allows you to debug kernel modules with a
	  kernel module aware debugger without using KALLSYMS.

config KGDB_SERIAL_CONSOLE
	tristate "KGDB: use kgdb over the serial console"
	select CONSOLE_POLL
	select MAGIC_SYSRQ
	default y
	help
	  Share a serial console with kgdb. Sysrq-g must be used
	  to break in initially.

config KGDB_8250
	tristate "8250/16550 and compatible serial support"
	depends on KGDB && SERIAL_8250
	select SERIAL_8250_CONSOLE
	help
	  Uses a 8250/16550 compatible serial ports to communicate with the
	  host GDB.  This is independent of the normal driver (SERIAL_8250)
	  for this chipset.  The port is configured via kgdb8250=<config>,
	  passed as kernel or module parameter, respectively.  The
	  configuration comes in two flavors:

	  <io|mmio>,<address>[/<regshift>],<baud rate>,<irq>
	    or
	  ttyS<n>,<baud rate>

	  When built into the kernel, this driver allows debugging of
	  the early boot process.  Note that, as long as the debugger is
	  attached via this driver,  the configured serial port cannot be
	  used by the standard 8250 driver or serial earlyprintk/earlycon.

config KGDBOE
	tristate "KGDB: On ethernet"
	depends on KGDB
	select NETPOLL
	select NETPOLL_TRAP
	help
	  Uses the NETPOLL API to communicate with the host GDB via UDP.
	  In order for this to work, the ethernet interface specified must
	  support the NETPOLL API, and this must be initialized at boot.
	  See the documentation for syntax.

config KGDB_TESTS
	bool "KGDB: internal test suite"
	default n
	help
	  This is a kgdb I/O module specifically designed to test
	  kgdb's internal functions.  This kgdb I/O module is
	  intended to for the development of new kgdb stubs
	  as well as regression testing the kgdb internals.
	  See the drivers/misc/kgdbts.c for the details about
	  the tests.  The most basic of this I/O module is to boot
	  a kernel boot arguments "kgdbwait kgdbts=V1F100"

config KGDB_TESTS_ON_BOOT
	bool "KGDB: Run tests on boot"
	depends on KGDB_TESTS
	default n
	help
	  Run the kgdb tests on boot up automatically without the need
	  to pass in a kernel parameter

config KGDB_TESTS_BOOT_STRING
	string "KGDB: which internal kgdb tests to run"
	depends on KGDB_TESTS_ON_BOOT
	default "V1F100"
	help
	  This is the command string to send the kgdb test suite on
	  boot.  See the drivers/misc/kgdbts.c for detailed
	  information about other strings you could use beyond the
	  default of V1F100.

endif # KGDB
```

## go12/linux-2.6.28.10/ltt/Kconfig
```kconfig
menu "Linux Trace Toolkit"

config LTT
	bool "Linux Trace Toolkit Instrumentation Support"
	depends on EXPERIMENTAL
	depends on TRACEPOINTS
	depends on MARKERS
	default y
	help
	  It is possible for the kernel to log important events to a trace
	  facility. Doing so enables the use of the generated traces in order
	  to reconstruct the dynamic behavior of the kernel, and hence the
	  whole system.

	  The tracing process contains 4 parts :
	      1) The logging of events by key parts of the kernel.
	      2) The tracer that keeps the events in a data buffer (uses
	         relay).
	      3) A trace daemon that interacts with the tracer and is
	         notified every time there is a certain quantity of data to
	         read from the tracer.
	      4) A trace event data decoder that reads the accumulated data
	         and formats it in a human-readable format.

	  If you say Y, the first component will be built into the kernel.

	  For more information on kernel tracing, lttctl, lttd or lttv,
	  please check the following address :
	       http://ltt.polymtl.ca

config LTT_TRACEPROBES
	tristate "Compile lttng tracing probes"
	depends on LTT
	default m
	help
	  Compile lttng tracing probes, which connect to the tracepoints when
	  loaded and format the information collected by the tracepoints with
	  the Markers.

config HAVE_LTT_DUMP_TABLES
	def_bool n

config LTT_RELAY_ALLOC
	def_bool n

config LTT_RELAY
	tristate "Linux Trace Toolkit High-speed Lockless Data Relay"
	select DEBUG_FS
	select LTT_RELAY_ALLOC
	depends on LTT_TRACER
	default y
	help
	  Support using the fast lockless algorithm to log the data obtained
	  through LTT.

	  If you don't have special hardware, you almost certainly want
	  to say Y here.

config LTT_RELAY_LOCKED
	tristate "Linux Trace Toolkit Lock-Protected Data Relay"
	select DEBUG_FS
	select LTT_RELAY_ALLOC
	depends on LTT_TRACER
	default n
	help
	  Support using the slow spinlock and interrupt disable algorithm to log
	  the data obtained through LTT.

config LTT_RELAY_CHECK_RANDOM_ACCESS
	bool "Debug check for random access in ltt relay buffers"
	depends on LTT_RELAY
	default n
	help
	  Add checks for random access to LTTng relay buffers. Given those
	  buffers are a linked list, such access are rather slow. Rare accesses
	  are OK; they can be caused by large writes (more than a page large) or
	  by reentrancy (e.g. interrupt nesting over the tracing code).

config LTT_SERIALIZE
	tristate "Linux Trace Toolkit Serializer"
	default y
	depends on LTT
	help
	  Library for serializing information from format string and argument
	  list to the trace buffers.

config LTT_MARKER_CONTROL
	tristate "Linux Trace Toolkit Marker Control"
	depends on LTT_SERIALIZE
	default y
	help
	  Interface (/proc/ltt) to enable markers.

config LTT_TRACER
	tristate "Linux Trace Toolkit Tracer"
	depends on LTT
	depends on LTT_MARKER_CONTROL
	default y
	help
	  If you enable this option, the Linux Trace Toolkit Tracer will be
	  either built in the kernel or as module.

	  Critical parts of the kernel will call upon the kernel tracing
	  function. The data is then recorded by the tracer if a trace daemon
	  is running in user-space and has issued a "start" command.

	  For more information on kernel tracing, the trace daemon or the event
	  decoder, please check the following address :
	       http://www.opersys.com/ltt
	  See also the experimental page of the project :
	       http://ltt.polymtl.ca

config LTT_ALIGNMENT
	bool "Align Linux Trace Toolkit Traces"
	depends on LTT
	default y
	help
	  This option enables dynamic alignment of data in buffers. The
	  alignment is made on the smallest size between architecture size
	  and the size of the value to be written.

	  Dynamically calculating the offset of the data has a performance cost,
	  but it is more efficient on some architectures (especially 64 bits) to
	  align data than to write it unaligned.

config LTT_DEBUG_EVENT_SIZE
	bool "Add event size field to LTT events for tracer debugging"
	depends on LTT
	default n
	help
	  Tracer-internal option to help debugging event type encoding problems.

config LTT_VMCORE
	bool "Support trace extraction from crash dump"
	depends on LTT
	default y
	help
	  If you enable this option, the Linux Trace Toolkit Tracer will
	  support extacting ltt log from vmcore, which can be generated with
	  kdump or LKCD tools.

	  Special crash extension should be used to extract ltt buffers.

config LTT_NETLINK_CONTROL
	tristate "Linux Trace Toolkit Netlink Controller"
	depends on LTT_TRACER
	depends on NET
	default m
	help
	  If you enable this option, the Linux Trace Toolkit Netlink Controller
	  will be either built in the kernel or as module.

config LTT_STATEDUMP
	tristate "Linux Trace Toolkit State Dump"
	depends on LTT_TRACER
	default m
	help
	  If you enable this option, the Linux Trace Toolkit State Dump will
	  be either built in the kernel or as module.

	  This module saves the state of the running kernel at trace start
	  into the trace buffers along with the ongoing tracing information.

config LTT_FTRACE
	bool "Linux Trace Toolkit Ftrace Support"
	depends on LTT_TRACER
	depends on FTRACE
	default y
	help
	  Integration of function entry trace with LTTng. Connect the
	  ftrace_cpu_start and ftrace_cpu_stop probes to markers to start/stop
	  function tracing while a trace is being taken. Typically used when the
	  surroundings of a problem has been identified in a prior trace.

endmenu
```
