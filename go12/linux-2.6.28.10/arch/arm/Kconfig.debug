## go12/linux-2.6.28.10/net/Kconfig.interpeak
```kconfig
#
# Network configurations specific for the Interpeak stack
#

config INTERPEAK
	bool "Use INTERPEAK TCP/IP networking"
	---help---
	Say Y if you want to prepare the kernel for using the Interpeak
	ANT/Linux network protocol stack (built externally).

	Say N for "Use native TCP/IP networking" (next option).

if INTERPEAK

source "net/Kconfig.ipmcrypto"

menu "General Networking Options"

menu "IPv4 Specific Options"

config INTERPEAK_IPV4
	bool "Enable IPv4 support"
	depends on INTERPEAK
	default y
	---help---
	Say Y if you want to have IPv4 support included.

if INTERPEAK_IPV4
config INTERPEAK_IPV4_FWD_CACHE_ORDER
       int "IPv4 forwarding cache order"
       range 1 31
       default 10
       ---help---
       Defines the order of the IPv4 forwarding cache, number of entries are
       (1 << order). Every entry takes ~24 bytes on a 32-bit CPU and ~32 bytes
       on a 64-bit CPU.

config INTERPEAK_CONF_IPV4_MIN_MTU
       int "Minimum path MTU for IPv4"
       default 68
       ---help---
       A host MUST never reduce its estimate of the Path MTU below 68 octets
       (RFC1191 chapter 3 page 4)

config INTERPEAK_RFC3927
	bool "IPv4 Link Local Address Configuration"
	depends on INTERPEAK_IPV4
	default y
	---help---
	Say Y if you want to use dynamic configuration of IPv4 link local
	addresses (RFC3927).

	The link local IPv4 addresses will be in the 169.254/16 network.
 	This feature is currently only supported on Ethernet and IEEE 802.11
	interfaces.

config INTERPEAK_RFC1256
	bool "ICMP Router Discovery"
       	depends on INTERPEAK_IPV4
	default y
	---help---
	This is an extension of the Internet Control Message Protocol (ICMP)
 	to enable hosts attached to multicast or broadcast networks to
	discover the IP addresses of their neighboring routers (RFC1256).

	Say Y if you want to enable this feature.

config INTERPEAK_RFC1256_ADVERTISEMENT
	bool "Enable Advertisement"
       	depends on INTERPEAK_RFC1256
	default n
	---help---
	Say Y if you want to have ICMP Router Advertisements (RFC1256) enabled
        by default on all interfaces where forwarding is enabled.
	Only applicable when the system is configured as a router.

config INTERPEAK_RFC1256_SOLICITATION
	bool "Enable Solicitation"
       	depends on INTERPEAK_RFC1256
	default n
	---help---
	Say Y if you want to have ICMP Router Solicitations (RFC1256) enabled
        by default on all interfaces where forwarding is not enabled.
	Only applicable when the system is configured as a host.


config INTERPEAK_NAT
	bool "Enable NAT support"
	depends on INTERPEAK_IPV4
	default y
	---help---
	Say Y if you want to use Network Address Translation (NAT)

config INTERPEAK_NAT_FTP_ALG
	bool "NAT:: Enable FTP ALG support"
	depends on INTERPEAK_NAT
	default y

config INTERPEAK_NAT_IPSEC_ALG
	bool "NAT:: Enable IPSec ALG support"
	depends on INTERPEAK_NAT
	default y

config INTERPEAK_NAT_PPTP_ALG
	bool "NAT:: Enable PPTP ALG support"
	depends on INTERPEAK_NAT
	default y

config INTERPEAK_NAT_H323_ALG
	bool "NAT:: Enable H323 ALG support"
	depends on INTERPEAK_NAT
	default y

config INTERPEAK_NAT_TRIGGER_ALG
	bool "NAT:: Enable Port Trigger ALG support"
	depends on INTERPEAK_NAT
	default y
endif
endmenu

menu "IPv6 Specific Options"

config INTERPEAK_IPV6
	bool "Enable IPv6 support"
	depends on INTERPEAK
	default y
	---help---
	Say Y if you want to use IPv6 support included.

if INTERPEAK_IPV6

config INTERPEAK_IPV6_FWD_CACHE_ORDER
       int "IPv6 forwarding cache order"
       range 1 31
       default 10
       ---help---
       Defines the order of the IPv6 forwarding cache, number of entries are
       (1 << order). Every entry takes ~52 bytes on a 32-bit CPU and
       ~56 bytes on a 64-bit CPU.

config INTERPEAK_CONF_IPV6_MIN_MTU
       int "Minimum path MTU for IPv6"
       default 1280
       ---help---
       A host MUST never reduce its estimate of the Path MTU below 68 octets
       (RFC1191 chapter 3 page 4)

config INTERPEAK_RFC4443
	bool "Use new ICMPv6 codes for \"Destination Unreachable\""
	depends on INTERPEAK_IPV6
	default y
	---help---
	Say Y if you want to make the networking stack to use the new codes
        for ICMPv6 "Destintation Unreachable" defined in RFC4443.

	Note: The networking stack will be able to process ICMPv6 messages
        containing these new codes regardless even with this option set to N.

if INTERPEAK_IPMCRYPTO
config INTERPEAK_RFC3041
	bool "Enable Privacy Extensions"
	depends on INTERPEAK_IPV6 && INTERPEAK_USE_MD5
	default y
	---help---
	Say Y if you want to use the Privacy extensions for Stateless Address
        Autoconfiguration (RFC3041) in IPv6.

	NOTE: This feature requires the IPMCRYPTO package built into the stack

config INTERPEAK_RFC3041_MAX_DESYNC_FACTOR
       int "Max resynchronization factor for Privacy Extensions"
       depends on INTERPEAK_RFC3041
       default 600
       ---help---
       Defines the maximum value of the resynchronization factor.

       The resynchronization factor is a random duration (in seconds) in the
       interval [0..MAX_DESYNC_FACTOR] generated on each host at boot.
       The MAX_DESYNC_FACTOR is included timeout calculations of temporary
       addresses to avoid that all clients updates their temporary addresses at
       the same time.

endif

config INTERPEAK_NAT_PT
	bool "Enable NAT-PT support"
	depends on INTERPEAK_IPV6 && INTERPEAK_IPV4 && INTERPEAK_NAT
	default y
	---help---
	Say Y if you want to use
        Network Address Translation - Protocol Translation (NAT)

config INTERPEAK_NAT_PT_DNS_ALG
	bool "NAT-PT:: Enable DNS ALG support"
	depends on INTERPEAK_NAT_PT
	default y
endif
endmenu

menu "Interface Specific Options"

config INTERPEAK_USE_VLAN
       bool "Enable VLAN support"
       default y
       depends on !CONFIG_VLAN_8021Q
       ---help---
       Say Y to use the built-in VLAN driver of the Interpeak ANT/Linux stack.

       This is an alternative to using the VLAN driver supported by the kernel.

config INTERPEAK_USE_PER_SOCKET_VLAN_TAG
       bool "Enable VLAN per socket tag"
       default y
       depends on INTERPEAK_USE_VLAN
       ---help---
       Say Y to make it possible to set the VLAN ID and VLAN priority of
       outgoing Ethernet frames via a socket option.


config INTERPEAK_USE_TUNNEL
       bool "Enable tunnel interface support"
       default y
       depends on INTERPEAK_IPV4 && INTERPEAK_USE_MCAST_ROUTING

if INTERPEAK_USE_TUNNEL
menu "Supported Tunnel Interface Types"

config INTERPEAK_USE_SIT
       bool "SIT"
       default y
       depends on INTERPEAK_IPV6
       ---help---
       Say Y to include support for SIT tunnel network interfaces.
       The interfaces will be called sitX and is used to automatically tunnel
       IPv6 packets over IPv4 when IPv6-compatible-IPv4 addresses are used.

config INTERPEAK_USE_6TO4
       bool "6to4"
       default y
       depends on INTERPEAK_IPV6
       ---help---
       say Y to include support for RFC3056 6to4 tunnel network interfaces.

       The interfaces will be called 6to4X and is used to automatically tunnel IPv6
       packets over IPv4 using 2002:IPv4::/48 addresses.

config INTERPEAK_USE_6OVER4
       bool "6over4"
       default y
       depends on INTERPEAK_IPV6
       ---help---
       Say Y to include support for RFC2529 6over4 tunnel network interfaces.

       The interfaces will be called 6over4X.
       A local IPv4 must be selected as the link address.

config INTERPEAK_USE_GRE
       bool "GRE"
       default y
       ---help---
       Say Y to include support for GRE tunnel network interfaces.

       The interfaces will be called greX.


endmenu
endif

menu "Interface Output Queues"
config INTERPEAK_USE_IFO_FIFO
       bool "FIFO"
       default y
       ---help---
       First In First Out queue

config INTERPEAK_USE_IFO_DPAF
       bool "DPAF"
       default y
       ---help---
       Drop Precedence Aware FIFO

config INTERPEAK_USE_IFO_RED
       bool "RED"
       default n
       ---help---
       Random Early Detection

config INTERPEAK_USE_IFO_NETEMU
       bool "NETEMU"
       default y
       ---help---
       Network Emulator

config INTERPEAK_USE_IFO_NULL
       bool "NULL"
       default y
       ---help---
       Null (black hole) queue
endmenu

menu "Supported Containers For Output Queues"

config INTERPEAK_USE_IFO_MBC
       bool "MBC"
       default y
       ---help---
       Multi Band Container

config INTERPEAK_USE_IFO_HTBC
       bool "HTBC"
       default y
       ---help---
       Hierarchical Token Bucket Container
endmenu
endmenu


config INTERPEAK_CONF_MAX_SOCKETS
       int "Max number of sockets"
       default 1024
       ---help---
       Maximum number of sockets that can be used at any time.

config INTERPEAK_CONF_INQ_MAX
       int "Max number of packets in input queue"
       default 100
       ---help---
        Maximum number of buffers in input queue processed by the
	ANT input deamon.

config INTERPEAK_CONF_REASSEMBLY_TIMEOUT
       int "Datagram reassembly timeout"
       default 60
       ---help---
       Number of seconds that incomplete datagram fragments will be
       kept in the reassembly list before discarding them.
       RFC2460 states a default value of 60 seconds

if INTERPEAK_IPMCRYPTO

config INTERPEAK_USE_MD5
       bool "Enable MD5 support"
       default y

endif

config INTERPEAK_IS_ROUTER
	bool "Enable router support"
	depends on INTERPEAK
	default y
	---help---
	Say Y if to configure the networking stack as a router.
	It is possible to change into a host stack in runtime even with
	this set to Y.
	The opposite is however not possible.

config INTERPEAK_STRICT_MODE
       bool "Enable strict mode"
       default n
       ---help---
       Say Y if you to configure the stack to use strict address mode.
       Say N to use loose mode.

       Strict mode requires packet to enter on the correct interface to be
       considered local. Loose mode will accept the packet if any interface
       has the unicast address. Most OS:es uses loose mode.

config INTERPEAK_USE_SOURCE_SPECIFIC_MCAST
       bool "Enable source specific multicast extensions"
       default y
       ---help---
       Say Y to include support for IGMPv3 (IPv4) and MLDv2 (IPv6).

       The stack will use IGMPv2 and MLDv1 if this feauture is set to N.


config INTERPEAK_USE_MCAST_ROUTING
       bool "Enable multicast routing"
       default y
       ---help---
       Say Y to enable multicast routing support in the networking stack.
       This applies to both IPv4 and IPv6 depending on the configuration.

choice
	prompt "Algorithm to use ECMP routing"
	default INTERPEAK_USE_ECMP_MODULO_N_HASH


config INTERPEAK_USE_ECMP_HIGHEST_RANDOM_WEIGHT
       bool "Highest Random Weight"
       ---help---
       The router computes a key for EACH next-hop by performing a
       hash over the packet header fields that identify the flow, as
       well as over the address of the next-hop.  The router then
       Chooses the next-hop with the highest resulting key value.
       his has the advantage of minimizing the number of flows
       affected by a next-hop addition or deletion (only 1/N of them),
       but is approximately N times as expensive as a modulo-N hash.
       Algorithm is described in RFC2991.

       Select to use the "Highest Random Weight" algorithm.


config INTERPEAK_USE_ECMP_MODULO_N_HASH
       bool "Modulo N Hash"
       ---help---
       To select a next-hop from the list of N next-hops, the router
       performs a modulo-N hash over the packet header fields that
       identify a flow.  This has the advantage of being fast, at the
       expense of (N-1)/N of all flows changing paths whenever a
       next-hop is added or removed.
       Algorithm is described in RFC2991.

       Select to use the "Modulo-N Hash" algorithm
endchoice

config INTERPEAK_USE_DIFFSERV
       bool "Enable differentiated services"
       default y
       ---help---
       Say Y to include support for differentiated services (diffserv).

if INTERPEAK_USE_DIFFSERV
choice
	prompt "Diffserv classifier mode"
	default INTERPEAK_DIFFSERV_CLASSIFIER_BA

config INTERPEAK_DIFFSERV_CLASSIFIER_BA
       bool "Behavior Aggregate"
       ---help---
       Select to run the classifier in Behavior Aggregate (BA) mode.
       The networking stack will only look at the DS field (TOS for IPv4,
       traffic class for IPv6) when classifying traffic.

config INTERPEAK_DIFFSERV_CLASSIFIER_MULTIFIELD
       bool "Multi-Field"
       ---help---
       Select to run the classifier in Multi-Field mode, this is slower than
       BA mode but it is now possible to match traffic on any field supported
       by the IPNET classifier.
endchoice
endif

config INTERPEAK_USE_RARP
       bool "Enable RARP support"
       default y
       depends on INTERPEAK_IPV4
       ---help---
       Say Y to include support for the RARP protocol in the stack.


endmenu

menu "Other Options"

config INTERPEAK_USE_FAST_IFNAME_LOOKUP
       bool "Enable fast interface lookups"
       default y
       ---help---
       Configure for fast (constant time) interface name lookup in the stack.

       Should be enabled on systems with a large amount of interfaces (>10000)

       This configuration allocates some extra memory.

config INTERPEAK_USE_ROUTE_TABLE_NAMES
       bool "Enable route table name support"
       default n
       ---help---
       Say Y to add support for identifying each route table with a string
       based name. The name can then be used to get the underlying virtual
       router index and table ID.

       This configuration allocates some extra memory.

config INTERPEAK_USE_ROUTE_COOKIES
       bool "Enable route cookie support"
       default n
       ---help---
       Say Y to add support for tagging each route table and route entry with
       a user supplied finger print.

       This configuration allocates some extra memory.

config INTERPEAK_USE_HW_CHECKSUM
       bool "Support for HW checksumming devices"
       default y
       ---help---
       Say Y to let the stack utilize Linux network device drivers that
       are able to do packet checksuming in hardware.

config INTERPEAK_USE_TSO
       bool "Use TSO"
       default n
       depends on INTERPEAK_USE_HW_CHECKSUM
       ---help---
       Say Y to enable support for network device driver specific per packet optimizations
       such as TCP Segmentation Offload (TSO)

config INTERPEAK_USE_SYSLOG
       bool "Use kernel log"
       default y
       ---help---
       Say Y to allow the stack generate kernel log messages, visible
       via dmesg or the system kernel log etc.

       It is usually always a good idea to set this option to Y.

choice
       prompt "Default log level"
       depends on INTERPEAK_USE_SYSLOG
       default INTERPEAK_SYSLOG_LEVEL_ERROR
       ---help---
       Default log level for the Interpeak ANT/Linux stack.

       0 - Emergency (system is unusable)
       1 - Critical
       2 - Error
       3 - Warning
       4 - Notice
       5 - Info
       6 - Debug
       7 - Verbose debug

       The log level can be altered in runtime via /proc/sys/net/ipnet/loglevel

config INTERPEAK_SYSLOG_LEVEL_EMERGENCY
       bool "Emergency (system is unusable)"

config INTERPEAK_SYSLOG_LEVEL_CRITICAL
       bool "Critical"

config INTERPEAK_SYSLOG_LEVEL_ERROR
       bool "Error"

config INTERPEAK_SYSLOG_LEVEL_WARNING
       bool "Warning"

config INTERPEAK_SYSLOG_LEVEL_NOTICE
       bool "Notice"

config INTERPEAK_SYSLOG_LEVEL_INFO
       bool "Informative"

config INTERPEAK_SYSLOG_LEVEL_DEBUG
       bool "Debug"

config INTERPEAK_SYSLOG_LEVEL_DEBUG2
       bool "Verbose debug"
endchoice



config INTERPEAK_USE_PROCFS
       bool "Enable /proc support"
       default y
       ---help---
       Say Y to make the stack support the API:s that are visible through
       /proc/net in the Linux process file system.

       Example: /proc/net/arp and /proc/net/route


       Say N to decrease the footprint of the stack.

       Some standard Linux networking tools such as "arp" and "route"
       will not work properly when this feature is disabled.

config INTEPEAK_USE_MIB2
       bool "Enable MIB-2 support in /proc"
       depends on INTERPEAK_USE_PROCFS
       default y
       ---help---
       Say Y to make the stack support SNMP MIB-2 API:s that are
       visible in /proc/net in the Linux process file system.

       Example: /proc/net/snmp and /proc/net/snmp6


       Say N to decrease the footprint of the stack.

       Standard Linux SNMP tools will not work properly with this feature
       disabled.

config INTERPEAK_USE_SYSCTL
       bool "Enable /proc/sys support"
       default y
       ---help---
       Say Y to make the stack support the sysctl API:s that are
       visible through /proc/sys/net in the Linux process file system.

       Example: /proc/sys/net/ipv4/ip_forward


       Say N to decrease the footprint of the stack.

       Some standard Linux networking tools will not work properly when this
       feature is disabled.

config INTERPEAK_USE_NETLINK
       bool "Enable netlink socket support"
       default y

       ---help---
       Say Y ro make stack add support for IPv4/IPv6 operations
       via the Linux Netlink API

       Say N to decrease the footprint of the stack.

       Some standard Linux networking tools such as 'ip' will not work properly
       when this feature is disabled.

config INTERPEAK_USE_ROUTESOCK
       bool "Enable BSD route socket support"
       default y

       ---help---
       Say Y ro make the networking stack add support for the BSD route socket API

       Say N to decrease the footprint of the stack.

       Some Interpeak ANT/Linux user space networking tools will not work properly when
       this feature is disabled.

config INTERPEAK_USE_ROUTESOCK_LINKINFO
       bool "BSD route socket link layer info"
       default n
       depends on INTERPEAK_USE_ROUTESOCK
       ---help---
       Say Y ro make the stack add support for information about added, deleted
       or changed ARP or NDP entries sent via the route socket API.

endmenu

source "net/Kconfig.ipipsec"

if INTERPEAK_IPIPSEC

menu "IPSec Options"

menu "General IPSec Configurations"
config INTERPEAK_IPSEC_USE_DAEMONS
       bool "Run IPSec in a separate context"
       default y
       depends on SMP
       ---help---
       Enable this to process ipsec in a separate context. This is
       typically used to improve performance on multi-core platforms.

config INTERPEAK_IPSEC_CONF_NUM_CPUS
       int "Number of CPUs reserved for IPSec"
       depends on INTERPEAK_IPSEC_USE_DAEMONS
       default	1
endmenu

menu "Transformation Modes"
config INTERPEAK_IPSEC_USE_ESP
       bool "Enable ESP"
       default y

config INTERPEAK_IPSEC_USE_AH
       bool "Enable AH"
       default y

config INTERPEAK_IPSEC_USE_IPIP
       bool "Enable IPIP"
       default y
config INTERPEAK_IPSEC_USE_ESN
       bool "Enable Extended Sequence Number (ESN)"
       default y
       depends on INTERPEAK_IPSEC_USE_ESP || INTERPEAK_IPSEC_USE_AH

config INTERPEAK_IPSEC_CONF_ESN_RESYNC_TRIGGER
       int "ESN resync trigger"
       default 1000
       depends on INTERPEAK_IPSEC_USE_ESN

config INTERPEAK_IPSEC_USE_TFC
       bool "Enable Traffic Flow Confidentiality (TFC) for ESP"
       default y
       depends on INTERPEAK_IPSEC_USE_ESP

menu "TFC Settings"
depends on INTERPEAK_IPSEC_USE_TFC

config INTERPEAK_IPSEC_MAX_TFC_BYTES
       int "Max TFC bytes"
       default 255

config INTERPEAK_IPSEC_MAX_TFC_DELAY
       int "Max TFC delay"
       default 10

config INTERPEAK_IPSEC_MIN_TFC_DELAY
       int "Min TFC delay"
       default 5

config INTERPEAK_IPSEC_MAX_DUMMY_PAYLOAD
       int "Max TFC dummy payload"
       default 500
endmenu
endmenu

menu "Authentication Algorithms"

config INTERPEAK_IPSEC_USE_MD5
       bool "Enable MD5"
       default y

config INTERPEAK_IPSEC_USE_SHA
       bool "Enable SHA"
       default y

config INTERPEAK_IPSEC_USE_RIPEMD
       bool "Enable RIPEMD"
       default y

config INTERPEAK_IPSEC_USE_AESMAC
       bool "Enable AESMAC"
       default y
endmenu

menu "Encryption Algorithms"

config INTERPEAK_IPSEC_USE_DES
       bool "Enable DES"
       default y
config INTERPEAK_IPSEC_USE_3DES
       bool "Enable 3DES"
       default y
config INTERPEAK_IPSEC_USE_AES
       bool "Enable AES"
       default y
config INTERPEAK_IPSEC_USE_AESCTR
       bool "Enable AESCTR"
       default y
config INTERPEAK_IPSEC_USE_BLOWFISH
       bool "Enable BLOWFISH"
       default y
config INTERPEAK_IPSEC_USE_CAST
       bool "Enable CAST"
       default y

endmenu
endmenu
endif

source "net/Kconfig.ipfirewall"

if INTERPEAK_IPFIREWALL

menu "Firewall Options"

config INTERPEAK_FW_USE_MAC_FILTER
       bool "Enable MAC filter"
       default y

config INTERPEAK_FW_USE_MAC_STATISTICS
       bool "Enable MAC filter statistics"
       depends on INTERPEAK_FW_USE_MAC_FILTER
       default y

config INTERPEAK_FW_BLOCK_IF_NO_MAC_MATCH
       bool "Block packets if no MAC filter rule matches"
       default n
       depends on INTERPEAK_FW_USE_MAC_FILTER
       ---help---
       Say Y  to block packets if no MAC filter rule matched.
       Default action is to pass packets that do not match any rules.

config INTERPEAK_FW_BLOCK_MAC_INVALID
       bool "Block invalid packets in the MAC filter"
       default n
       depends on INTERPEAK_FW_USE_MAC_FILTER
       ---help---
       Say Y to block invalid packets in the MAC filter.
       Invalid packets arevpackets that are too short to contain a
       complete MAC header.

config INTERPEAK_FW_USE_IP_FILTER
       bool "Enable IP filter"
       default y

config INTERPEAK_FW_USE_IP_STATEFUL
       bool "Enable stateful IP filter"
       depends on INTERPEAK_FW_USE_IP_FILTER
       default y

config INTERPEAK_FW_USE_IP_STATISTICS
       bool "Enable IP filter statistics"
       depends on INTERPEAK_FW_USE_IP_FILTER
       default y

config INTERPEAK_FW_USE_USERDEF
       bool "Enable user defined extensions to IP filter"
       depends on INTERPEAK_FW_USE_IP_FILTER
       default y

config INTERPEAK_FW_BLOCK_IF_NO_IP_MATCH
       bool "Block packets if no IP filter rule matches"
       depends on INTERPEAK_FW_USE_IP_FILTER
       default n
       ---help---
       Say Y to block packets if no IP filter rule matches.
       Default action is to pass packets that do not match any rules.

config INTERPEAK_FW_BLOCK_IP_INVALID
       bool "Block invalid packets in the IP filter"
       depends on INTERPEAK_FW_USE_IP_FILTER
       default n
       ---help---
       Say Y to block invalid packets in the IP filter.
       Invalid packets are packets that are too short to contain a
       complete transport header.

config INTERPEAK_FW_HTTP_FILTER
       bool "Enable HTTP filter"
       default y

endmenu
endif

source "net/Kconfig.ipforwarder"


if INTERPEAK_IPFWD && CPU_CAVIUM_OCTEON

menu "Fast IP Forwarder Options"

config INTERPEAK_IPFWD_NUM_FORWARDERS
       int "Number of Forwarder threads (1-7)"
       range 1 7
       depends on SMP && !INTERPEAK_IPFWD_BIND_INPUT_PORT_TO_FORWARDER
       default	4

config INTERPEAK_IPFWD_SINGLE_OUTPUT_QUEUE
       bool "Use a single output queue per interface"
       default n
       ---help---
       Say Y to make the Forwarders use the same per interface output queue.
       Say N to make each Forwarder have its own per interface output queue.

config INTERPEAK_IPFWD_BIND_INPUT_PORT_TO_FORWARDER
       bool "Bind each input port to a Forwarder"
       default n
       ---help---
       Say Y to make each input interface have a specific Forwarder
       bound to it. Only that forwarder will receive packets.
       Say N to make any Forwarder receive packets from any interface.

config INTERPEAK_IPFWD_FORWARDER_CACHE_SIZE
       int "Forwarder flow cache size (8-16)"
       range 8 16
       default 8
       ---help---
       Number of entries in the cache is calclauted as 2^FORWARDER_CACHE_SIZE,
       where FORWARDER_CACHE_SIZE is between 8 and 16.

endmenu
endif

endif
```
